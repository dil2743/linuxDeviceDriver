## workspace/ldd/driver/char/my_c_dev/Kconfig
```kconfig
menu "my custom C module!"
	config CUSTOM_HELLOWORLD
		tristate "hello world module support to inline kernel"
		default m
endmenu
```

## workspace/ldd/source/linux-6.1.83-ti-rt-r37/drivers/char/my_c_dev/Kconfig
```kconfig
menu "Dilshad custom C module!"
config CUSTOM_HELLOWORLD
	tristate "hello world module support to inline kernel"
	default n
endmenu
```
